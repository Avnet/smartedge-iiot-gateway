/dts-v1/;
/plugin/;

/ {
	compatible = "brcm,bcm2835", "brcm,bcm2708", "brcm,bcm2709";

	/* Ensure SPI2 enabled */
	fragment@0 {
		target = <&spi2>;
		__overlay__ {
			status = "okay";
		};
	};

	/* Disable TPM */
	fragment@1 {
		target = <&tpm_tis22>;
		__overlay__ {
			status = "disabled";
		};
	};

	/* Enable spidev2_2 */
	fragment@2 {
		target = <&spi2>;
		__overlay__ {
			#address-cells = <1>;
			#size-cells = <0>;

			spidev2_2: spidev@2{
				compatible = "spidev";
				reg = <2>;
				spi-max-frequency = <500000>;
				status = "okay";
			};
		};
	};
};
